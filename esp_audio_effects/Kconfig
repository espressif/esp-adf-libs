## esp_audio_effects/Kconfig
```kconfig
menu "Audio Effects Configuration"
    config ESP_AUDIO_EFFECTS_S31_USE_ASM
        bool "Use ESP32-S31 assembly-optimized effects libraries"
        depends on IDF_TARGET_ESP32S31
        default y
        help
            Select the assembly-optimized libraries from the esp32s31
            directory. Disable this option to use the portable C
            implementation from the esp32s31_esp_c directory.
            esp_ae_utils basic ops always remain assembly-capable and
            are not gated by this option.
endmenu
```

## esp_efc_codec/Kconfig
```kconfig
menu "ESP-EFC codec"

    config ESP_EFC_DECODE_4X4_ONLY
        bool "Decode only fixed 4x4-grid blobs (smaller and faster)"
        default y
        help
            Compile the decoder with ONLY the fixed 4x4-grid path. The
            8x8/general-grid and quadtree decoders are removed (less code), and
            the tile size becomes a compile-time constant so the inner loops
            unroll (faster). esp_efc_dec_open() then rejects any non-(fixed,4)
            blob.

            Pair with encoding at tile=4. Disable this if you need to decode
            8x8 or quadtree blobs.

    config ESP_EFC_USE_SIMD
        bool "Use 128-bit PIE SIMD for bulk pixel moves"
        default y
        help
            On ESP32-P4 (RISC-V PIE) and ESP32-S3 (Xtensa PIE), route the
            decoder's bulk pixel copies through a 128-bit-vector memcpy written
            in assembly. Ignored on targets without the PIE vector unit (the
            portable C path is used instead).

    config ESP_EFC_LVGL_WIDGET
        bool "LVGL EFC player widget (lv_efc)"
        default n
        help
            Compile lv_efc, an LVGL image widget that plays an EFC clip.
            Requires LVGL 9

    config ESP_EFC_PERF_LOG
        bool "Log EFC player stage timing"
        depends on ESP_EFC_LVGL_WIDGET
        default n
        help
            Once per second, log average time spent decoding, preparing the
            scaled/alpha image, publishing it to LVGL, and outside the EFC
            timer callback. Intended for performance diagnosis.

endmenu
```

## esp_efc_codec/test_app/main/Kconfig
```kconfig
menu "EFC Decoder Test Configuration"
    config EFC_DECODER_BENCH_WITH_FILE
        bool "EFC VS EAF use real file"
        default y
endmenu
```

## esp_image_effects/Kconfig
```kconfig
menu "Image Effects Configuration"
    config ESP_IMAGE_EFFECTS_S31_USE_ASM
        bool "Use ESP32-S31 assembly-optimized image effects libraries"
        depends on IDF_TARGET_ESP32S31
        default n
        help
            Select the assembly-optimized libraries from the esp32s31
            directory. Disable this option to use the portable C
            implementation from the esp32s31_esp_c directory.
endmenu
```
