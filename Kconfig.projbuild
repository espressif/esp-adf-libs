## esp_video_codec/Kconfig
```kconfig
menu "Video Codec Configuration"
    menu "Video Decoder Configuration"
        config VIDEO_DECODER_SW_H264_SUPPORT
            bool "Support SW H264 Decoder"
            default y
            depends on IDF_TARGET_ESP32S3 || IDF_TARGET_ESP32P4
            help
                Enable this option to register software H264 decoder

        config VIDEO_DECODER_SW_MJPEG_SUPPORT
            bool "Support SW MJPEG Decoder"
            default y
            help
                Enable this option to register software MJPEG decoder

        config VIDEO_DECODER_HW_MJPEG_SUPPORT
            bool "Support HW MJPEG Decoder"
            default y
            depends on SOC_JPEG_DECODE_SUPPORTED
            help
                Enable this option to register hardware MJPEG decoder
    endmenu

    menu "Video Encoder Configuration"
        config VIDEO_ENCODER_HW_H264_SUPPORT
            bool "Support HW H264 Encoder"
            default y
            depends on IDF_TARGET_ESP32P4
            help
                Enable this option to register hardware H264 encoder

        config VIDEO_ENCODER_SW_H264_SUPPORT
            bool "Support SW H264 Encoder"
            default y
            depends on IDF_TARGET_ESP32S3 || IDF_TARGET_ESP32P4
            help
                Enable this option to register software H264 encoder

        config VIDEO_ENCODER_HW_MJPEG_SUPPORT
            bool "Support HW MJPEG Encoder"
            default y
            depends on SOC_JPEG_ENCODE_SUPPORTED
            help
                Enable this option to register hardware MJPEG encoder

        config VIDEO_ENCODER_SW_MJPEG_SUPPORT
            bool "Support SW MJPEG Encoder"
            default y
            help
                Enable this option to register software MJPEG encoder
    endmenu

 endmenu
```

## esp_video_codec/test_apps/video_codec_test/sdkconfig.defaults
```kconfig
CONFIG_SPIRAM=y
CONFIG_FREERTOS_HZ=1000
CONFIG_ESP_TASK_WDT=n
CONFIG_ESP_MAIN_TASK_STACK_SIZE=30000
CONFIG_COMPILER_OPTIMIZATION_PERF=y
CONFIG_ESP32P4_REV_MIN_0=y
CONFIG_SPIRAM_SPEED_200M=y
CONFIG_IDF_EXPERIMENTAL_FEATURES=y
```
