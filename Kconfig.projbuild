## Kconfig.projbuild
```kconfig
menu "Speech Recognition Configuration"

choice SR_MODEL_SEL
    prompt "Speech recognition wake net to use"
    default SR_MODEL_WN5_QUANT
    help
        Select the wake net to be used.

config SR_MODEL_WN3_QUANT
    bool "WakeNet 3 (quantized)"

config SR_MODEL_WN4_QUANT
    bool "WakeNet 4 (quantized)"

config SR_MODEL_WN5_QUANT
    bool "WakeNet 5 (quantized)"

endchoice

choice NAME_OF_WAKEUP_WORD
    prompt "Name of wakeup word"
    default WAKEUP_WORD_HI_LEXIN
    help
        Select wakeup word

config WAKEUP_WORD_HI_LEXIN
    bool "Wakeup word is Hi Lexin"
    depends on SR_MODEL_WN3_QUANT || SR_MODEL_WN5_QUANT

config WAKEUP_WORD_ALEXA
    bool "Wakeup word is Alexa"
    depends on SR_MODEL_WN3_QUANT || SR_MODEL_WN5_QUANT

config WAKEUP_WORD_LIGHT_CONTROL_CH
    bool "Light control commands with Chinese"
    depends on SR_MODEL_WN4_QUANT

config WAKEUP_WORD_SPEECH_CMD_CH
    bool "Music control commands with Chinese"
    depends on SR_MODEL_WN4_QUANT

endchoice

choice RECORD_ENGINE_MODE
    prompt "Choose recorder engine functionality"
    default REC_ENG_ENABLE_VAD_WWE_AMR
    help
        Recorder engine have VAD, WWE and AMR encoding functionality.
        AMR encoding enabled, the binary size increase 144kB.
        WWE enabled, the binary size increase 103kB.

config REC_ENG_ENABLE_VAD_ONLY
    bool "VAD ONLY"

config REC_ENG_ENABLE_VAD_WWE
    bool "VAD and WWE"

config REC_ENG_ENABLE_VAD_WWE_AMR
    bool "VAD, WWE and AMR encoding"

endchoice


endmenu
```

## esp_audio_codec/test_apps/audio_codec_test/sdkconfig.defaults
```kconfig
CONFIG_FREERTOS_HZ=1000
CONFIG_ESP_TASK_WDT=n
CONFIG_ESP_MAIN_TASK_STACK_SIZE=6000
CONFIG_COMPILER_OPTIMIZATION_PERF=y
CONFIG_PARTITION_TABLE_SINGLE_APP_LARGE=y
```

## esp_audio_codec/test_apps/audio_codec_test/sdkconfig.defaults.esp32s3
```kconfig
CONFIG_ESP32S3_INSTRUCTION_CACHE_32KB=y
CONFIG_ESP32S3_INSTRUCTION_CACHE_SIZE=0x8000
CONFIG_ESP32S3_INSTRUCTION_CACHE_LINE_32B=y
CONFIG_ESP32S3_INSTRUCTION_CACHE_LINE_SIZE=32
CONFIG_ESP32S3_DATA_CACHE_64KB=y
CONFIG_ESP32S3_DATA_CACHE_SIZE=0x10000
CONFIG_ESP32S3_DATA_CACHE_LINE_64B=y
CONFIG_ESP32S3_DATA_CACHE_LINE_SIZE=64
CONFIG_ESP_DEFAULT_CPU_FREQ_MHZ_240=y
CONFIG_SPIRAM=y
CONFIG_SPIRAM_SPEED_80M=y
CONFIG_SPIRAM_MODE_OCT=y
```

## esp_audio_effects/example/ae_howl/sdkconfig.defaults
```kconfig
#
# Serial flasher config
#
CONFIG_ESPTOOLPY_FLASHMODE_QIO=y
CONFIG_ESPTOOLPY_FLASHFREQ_80M=y

#
# Partition Table
#
CONFIG_PARTITION_TABLE_CUSTOM=y
CONFIG_PARTITION_TABLE_CUSTOM_FILENAME="partition.csv"
CONFIG_PARTITION_TABLE_FILENAME="partition.csv"
CONFIG_PARTITION_TABLE_OFFSET=0x8000
CONFIG_PARTITION_TABLE_MD5=y

#
# Compiler options
#
CONFIG_COMPILER_OPTIMIZATION_PERF=y

#
# FreeRTOS
#
CONFIG_FREERTOS_HZ=1000
CONFIG_FREERTOS_ENABLE_BACKWARD_COMPATIBILITY=y

#
# ESP System Settings
#
CONFIG_MAIN_TASK_STACK_SIZE=3072
CONFIG_ESP_MAIN_TASK_STACK_SIZE=6000
CONFIG_ESP_TASK_WDT=n

#
# FAT Filesystem support
#
CONFIG_FATFS_VOLUME_COUNT=2
CONFIG_FATFS_LFN_HEAP=y
CONFIG_FATFS_SECTOR_4096=y
CONFIG_FATFS_CODEPAGE_936=y
CONFIG_FATFS_CODEPAGE=936
CONFIG_FATFS_MAX_LFN=255
CONFIG_FATFS_API_ENCODING_UTF_8=y
CONFIG_FATFS_FS_LOCK=5
CONFIG_FATFS_TIMEOUT_MS=10000
CONFIG_FATFS_PER_FILE_CACHE=y
CONFIG_FATFS_VFS_FSTAT_BLKSIZE=0
```

## esp_audio_effects/example/ae_howl/sdkconfig.defaults.esp32s3
```kconfig
#
# ESP32-S3 Cache
#
CONFIG_ESP32S3_INSTRUCTION_CACHE_32KB=y
CONFIG_ESP32S3_INSTRUCTION_CACHE_SIZE=0x8000
CONFIG_ESP32S3_INSTRUCTION_CACHE_LINE_32B=y
CONFIG_ESP32S3_INSTRUCTION_CACHE_LINE_SIZE=32
CONFIG_ESP32S3_DATA_CACHE_64KB=y
CONFIG_ESP32S3_DATA_CACHE_SIZE=0x10000
CONFIG_ESP32S3_DATA_CACHE_LINE_64B=y
CONFIG_ESP32S3_DATA_CACHE_LINE_SIZE=64

#
# ESP System Settings
#
CONFIG_ESP_DEFAULT_CPU_FREQ_MHZ_240=y

#
# Serial flasher config
#
CONFIG_ESPTOOLPY_FLASHSIZE_8MB=y
```

## esp_audio_effects/example/esp_audio_effects_demo/main/Kconfig.projbuild
```kconfig
menu "Audio Effects Example"

choice ESP_AUDIO_EFFECTS_DEMO_SELECT
    prompt "Audio effect element"
    default ESP_AUDIO_EFFECTS_DEMO_SELECT_ALC

config ESP_AUDIO_EFFECTS_DEMO_SELECT_ALC
    bool "ALC"

config ESP_AUDIO_EFFECTS_DEMO_SELECT_SONIC
    bool "Sonic"

config ESP_AUDIO_EFFECTS_DEMO_SELECT_EQ
    bool "EQ"

config ESP_AUDIO_EFFECTS_DEMO_SELECT_FADE
    bool "Fade"

config ESP_AUDIO_EFFECTS_DEMO_SELECT_DRC
    bool "DRC"

config ESP_AUDIO_EFFECTS_DEMO_SELECT_MBC
    bool "MBC"

config ESP_AUDIO_EFFECTS_DEMO_SELECT_MIXER
    bool "Mixer"

config ESP_AUDIO_EFFECTS_DEMO_SELECT_BASIC_AUDIO_INFO_CVT
    bool "Basic Audio Info Convert"

endchoice

choice ESP_AUDIO_EFFECTS_DEMO_DRC_DEMO_SELECT
    prompt "DRC Demo"
    depends on ESP_AUDIO_EFFECTS_DEMO_SELECT_DRC
    default ESP_AUDIO_EFFECTS_DEMO_SOUND_BALANCE_DEMO

config ESP_AUDIO_EFFECTS_DEMO_SOUND_BALANCE_DEMO
    bool "Sound Balance Demo"
    help
        Enable sound balance demo when DRC is selected

config ESP_AUDIO_EFFECTS_DEMO_REMOVE_HIT_DEMO
    bool "Remove Hit Demo"
    help
        Enable remove hit demo when DRC is selected

endchoice

endmenu
```

## esp_audio_effects/example/esp_audio_effects_demo/sdkconfig.defaults.esp32s3
```kconfig
CONFIG_ESP32S3_INSTRUCTION_CACHE_32KB=y
CONFIG_ESP32S3_INSTRUCTION_CACHE_SIZE=0x8000
CONFIG_ESP32S3_INSTRUCTION_CACHE_LINE_32B=y
CONFIG_ESP32S3_INSTRUCTION_CACHE_LINE_SIZE=32
CONFIG_ESP32S3_DATA_CACHE_64KB=y
CONFIG_ESP32S3_DATA_CACHE_SIZE=0x10000
CONFIG_ESP32S3_DATA_CACHE_LINE_64B=y
CONFIG_ESP32S3_DATA_CACHE_LINE_SIZE=64
CONFIG_ESP_DEFAULT_CPU_FREQ_MHZ_240=y
CONFIG_SPIRAM=y
CONFIG_SPIRAM_SPEED_80M=y
CONFIG_SPIRAM_MODE_OCT=y

CONFIG_ESPTOOLPY_FLASHMODE_QIO=y
CONFIG_ESPTOOLPY_FLASHFREQ_80M=y
CONFIG_ESPTOOLPY_FLASHSIZE_8MB=y
CONFIG_FREERTOS_ENABLE_BACKWARD_COMPATIBILITY=y
```

## esp_audio_effects/test_app/main/Kconfig.projbuild
```kconfig
menu "ESP Audio Effects UT Configuration"

config EXAMPLE_WIFI_SSID
    string "WiFi SSID"
    default "xxxx"
    help
        WiFi SSID used by the rate converter test app.

config EXAMPLE_WIFI_PASSWORD
    string "WiFi Password"
    default "xxxx"
    help
        WiFi password used by the rate converter test app.

config WIFI_FS_SERVER_IP
    string "WiFi FS server IP"
    default "111.111.111.111"
    help
        File server IP address used by the WiFi file system.

config WIFI_FS_SERVER_PORT
    int "WiFi FS server port"
    range 1 65535
    default 3333
    help
        File server port used by the WiFi file system.

endmenu
```

## esp_audio_effects/test_app/sdkconfig.defaults
```kconfig
# Override some defaults so BT stack is enabled and
# Classic BT is enabled and BT_DRAM_RELEASE is disabled
CONFIG_FREERTOS_USE_TRACE_FACILITY=y
CONFIG_FREERTOS_USE_STATS_FORMATTING_FUNCTIONS=y
CONFIG_FREERTOS_GENERATE_RUN_TIME_STATS=y
CONFIG_FREERTOS_RUN_TIME_STATS_USING_ESP_TIMER=y
CONFIG_FREERTOS_RUN_TIME_STATS_USING_CPU_CLK=y

CONFIG_FREERTOS_ENABLE_BACKWARD_COMPATIBILITY=y
CONFIG_FREERTOS_PLACE_FUNCTIONS_INTO_FLASH=y

#
# Serial flasher config
#
CONFIG_ESPTOOLPY_FLASHSIZE_4MB=y

#
# FAT Filesystem support
#
CONFIG_FATFS_CODEPAGE_936=y
CONFIG_FATFS_LFN_HEAP=y
CONFIG_FATFS_FS_LOCK=20

#
# SPI RAM config
#
CONFIG_MAIN_TASK_STACK_SIZE=3072
CONFIG_SPIRAM=y
CONFIG_SPIRAM_IGNORE_NOTFOUND=y
CONFIG_SPIRAM_ALLOW_STACK_EXTERNAL_MEMORY=y
CONFIG_SPIRAM_TRY_ALLOCATE_WIFI_LWIP=y

#
# Wi-Fi buffer tuning for TCP throughput
#
CONFIG_ESP_WIFI_STATIC_RX_BUFFER_NUM=16
CONFIG_ESP_WIFI_DYNAMIC_RX_BUFFER_NUM=64
CONFIG_ESP_WIFI_DYNAMIC_TX_BUFFER_NUM=64
CONFIG_ESP_WIFI_RX_BA_WIN=32
CONFIG_ESP_WIFI_TX_BA_WIN=32
CONFIG_ESP_WIFI_IRAM_OPT=y
CONFIG_ESP_WIFI_RX_IRAM_OPT=y

#
# lwIP TCP/IP tuning for TCP throughput
#
CONFIG_LWIP_TCP_SND_BUF_DEFAULT=65535
CONFIG_LWIP_TCP_WND_DEFAULT=65535
CONFIG_LWIP_TCP_RECVMBOX_SIZE=64
CONFIG_LWIP_UDP_RECVMBOX_SIZE=64
CONFIG_LWIP_TCPIP_RECVMBOX_SIZE=64
CONFIG_LWIP_TCP_SACK_OUT=y
CONFIG_LWIP_IRAM_OPTIMIZATION=y
CONFIG_LWIP_TCPIP_TASK_PRIO=23

CONFIG_FREERTOS_HZ=1000
CONFIG_ESP_TASK_WDT=n
CONFIG_ESP_MAIN_TASK_STACK_SIZE=6000
CONFIG_COMPILER_OPTIMIZATION_PERF=y
CONFIG_PARTITION_TABLE_SINGLE_APP_LARGE=y
```

## esp_audio_effects/test_app/sdkconfig.defaults.esp32s3
```kconfig
CONFIG_ESP32S3_INSTRUCTION_CACHE_32KB=y
CONFIG_ESP32S3_INSTRUCTION_CACHE_SIZE=0x8000
CONFIG_ESP32S3_INSTRUCTION_CACHE_LINE_32B=y
CONFIG_ESP32S3_INSTRUCTION_CACHE_LINE_SIZE=32
CONFIG_ESP32S3_DATA_CACHE_64KB=y
CONFIG_ESP32S3_DATA_CACHE_SIZE=0x10000
CONFIG_ESP32S3_DATA_CACHE_LINE_64B=y
CONFIG_ESP32S3_DATA_CACHE_LINE_SIZE=64
CONFIG_ESP_DEFAULT_CPU_FREQ_MHZ_240=y
CONFIG_SPIRAM=y
CONFIG_SPIRAM_SPEED_80M=y
CONFIG_SPIRAM_MODE_OCT=y

CONFIG_ESPTOOLPY_FLASHMODE_QIO=y
CONFIG_ESPTOOLPY_FLASHFREQ_80M=y
CONFIG_ESPTOOLPY_FLASHSIZE_4MB=y

CONFIG_FATFS_LFN_STACK=y
CONFIG_FATFS_API_ENCODING_UTF_8=y

#
# Partition Table
#
CONFIG_PARTITION_TABLE_CUSTOM=y
CONFIG_PARTITION_TABLE_CUSTOM_FILENAME="partition_table_unit_test_app.csv"
CONFIG_PARTITION_TABLE_FILENAME="partition_table_unit_test_app.csv"
CONFIG_PARTITION_TABLE_OFFSET=0x8000
CONFIG_PARTITION_TABLE_MD5=y
# end of Partition Table

CONFIG_FREERTOS_ENABLE_BACKWARD_COMPATIBILITY=y
```

## esp_extractor/Kconfig
```kconfig
menu "Espressif Extractor Configuration"
    config EXTRACTOR_CUSTOM_SUPPORT
        bool "Support customized Extractor"
        default y
        help
            Enable this option to export customized API to user

    config WAV_EXTRACTOR_SUPPORT
        bool "Support WAV Extractor"
        default y
        help
            Enable this option to register WAV Extractor

    config MP4_EXTRACTOR_SUPPORT
        bool "Support MP4 Extractor"
        default y
        help
            Enable this option to register MP4 Extractor

    config TS_EXTRACTOR_SUPPORT
        bool "Support TS Extractor"
        default y
        help
            Enable this option to register TS Extractor

    config OGG_EXTRACTOR_SUPPORT
        bool "Support OGG Extractor"
        default y
        help
            Enable this option to register OGG extractor

    config AVI_EXTRACTOR_SUPPORT
        bool "Support AVI Extractor"
        default y
        help
            Enable this option to register AVI Extractor

    config AUDIO_ES_EXTRACTOR_SUPPORT
        bool "Support Audio ES Extractor"
        default y
        help
            Enable this option to register (aac, mp3, flac, amr etc) Extractor

    config CAF_EXTRACTOR_SUPPORT
        bool "Support CAF Extractor"
        default y
        help
            Enable this option to register CAF Extractor

    config FLV_EXTRACTOR_SUPPORT
        bool "Support FLV Extractor"
        default y
        help
            Enable this option to register FLV Extractor

    config EXTRACTOR_HELPER_FILE_IO_CACHE_SIZE
        int "File IO cache size setting for better read peformance"
        range 1024 64000
        default 1024
        help
            When read use unaligned address will cause file read peformance poor.
            Aligned cache setting for `setvbuf` can achieve high read speed.
 endmenu
```

## esp_extractor/examples/extractor_test/main/Kconfig
```kconfig
menu "Extractor Helper Configuration"
    config EXTRACTOR_HELPER_FILE_IO_CACHE_SIZE
        int "File IO cache size setting for better read performance"
        range 1024 64000
        default 1024
        help
            When read use unaligned address will cause file read performance poor.
            Aligned cache setting for `setvbuf` can achieve high read speed.
    config EXTRACTOR_ID3_PARSER_ENABLE
        bool "Support ID3 Parser"
        default y
        help
            Enable this option to enable ID3 parser
endmenu
```

## esp_extractor/examples/extractor_test/sdkconfig.defaults
```kconfig
# Enable FreeRTOS trace
CONFIG_FREERTOS_HZ=1000

# Partition table
CONFIG_PARTITION_TABLE_SINGLE_APP_LARGE=y

# FatFS
CONFIG_FATFS_LFN_HEAP=y
```

## esp_media_protocols/test_apps/sdkconfig.defaults
```kconfig
CONFIG_ESP_TASK_WDT_EN=n
CONFIG_UNITY_ENABLE_IDF_TEST_RUNNER=y
CONFIG_MEDIA_LIB_CRYPT_ENABLE=y
```

## esp_midi/examples/keyboard/main/Kconfig.projbuild
```kconfig
menu "Keyboard Example Configuration"

    choice INPUR_KEY
        prompt "Input Key Selection"
        default INPUT_KEY_MATRIX_KEYBOARD
        help
            Select the input key type for the example.

        config INPUT_KEY_USB_KEYBOARD
            bool "USB Keyboard"
        config INPUT_KEY_MATRIX_KEYBOARD
            bool "Matrix Keyboard"
    endchoice

endmenu
```

## esp_midi/examples/keyboard/sdkconfig.defaults
```kconfig
# Espressif IoT Development Framework (ESP-IDF) 5.4.3 Project Minimal Configuration
#
CONFIG_ESPTOOLPY_FLASHMODE_QIO=y
CONFIG_ESPTOOLPY_FLASHSIZE_16MB=y
CONFIG_PARTITION_TABLE_CUSTOM=y
CONFIG_COMPILER_OPTIMIZATION_SIZE=y
CONFIG_SPIRAM=y
CONFIG_FATFS_LFN_HEAP=y
CONFIG_FATFS_CODEPAGE_936=y
CONFIG_FREERTOS_HZ=1000
CONFIG_FREERTOS_ENABLE_BACKWARD_COMPATIBILITY=y
```

## esp_midi/examples/keyboard/sdkconfig.defaults.esp32s3
```kconfig
CONFIG_IDF_TARGET="esp32s3"
CONFIG_SPIRAM_SPEED_80M=y
CONFIG_ESP_DEFAULT_CPU_FREQ_MHZ_240=y
CONFIG_ESP32S3_DATA_CACHE_64KB=y
CONFIG_ESP32S3_DATA_CACHE_LINE_64B=y
```

## esp_midi/examples/play/sdkconfig.defaults.esp32s3
```kconfig
CONFIG_IDF_TARGET="esp32s3"
CONFIG_SPIRAM_MODE_OCT=y
CONFIG_SPIRAM_SPEED_80M=y
CONFIG_ESP_DEFAULT_CPU_FREQ_MHZ_240=y
```

## esp_muxer/Kconfig
```kconfig
menu "ESP_Muxer Configuration"

    config ESP_MUXER_MP4_SUPPORT
        bool "Support MP4 Muxer"
        default y
        help
            Enable this option to register MP4 muxer

    config ESP_MUXER_TS_SUPPORT
        bool "Support TS Muxer"
        default y
        help
            Enable this option to register TS muxer

    config ESP_MUXER_OGG_SUPPORT
        bool "Support OGG Muxer"
        default y
        help
            Enable this option to register OGG muxer

    config ESP_MUXER_WAV_SUPPORT
        bool "Support WAV Muxer"
        default y
        help
            Enable this option to register WAV muxer

    config ESP_MUXER_FLV_SUPPORT
        bool "Support FLV Muxer"
        default y
        help
            Enable this option to register FLV muxer

    config ESP_MUXER_CAF_SUPPORT
        bool "Support CAF Muxer"
        default y
        help
            Enable this option to register CAF muxer

endmenu
```
